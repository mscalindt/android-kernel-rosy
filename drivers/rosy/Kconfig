## drivers/rosy/Kconfig
```kconfig
#
# Kconfig for ROSY drivers
#

menu "Drivers for ROSY"

source "drivers/rosy/fingerprint/Kconfig"

source "drivers/rosy/touchscreen/Kconfig"

source "drivers/rosy/led/Kconfig"

source "drivers/rosy/soc/Kconfig"

source "drivers/rosy/sound/Kconfig"

config DTS_ROSY
	bool "ROSY DTS"
	select CONFIG_ARCH_SDM450
	help
	  Say Y here to build ROSY DTS.

	  If unsure, say Y.

config PSTORE_ROSY
	bool "PSTORE support"
	select PSTORE
	select PSTORE_RAM
	help
	  Say Y here to enable persistent storage support. A RAM
	  buffer will be reserved so that ramoops can be read on
	  next boot. When a panic happens, you will be able to
	  read dmesg at /sys/fs/pstore/dmesg-ramoops-X

if PSTORE_ROSY

config LAST_KMSG_ROSY
	bool "Last kernel messages interface"
	select PSTORE_CONSOLE
	help
	  Say Y here to enable proc interface used for storing the
	  last kernel messages (kernel messages will always be
	  logged, irrespective of kernel condition). The interface
	  is located at /proc/last_kmsg

	  If unsure, say Y.

endif

endmenu
```

## drivers/rosy/fingerprint/fpc/Kconfig
```kconfig
config FPC1020_ROSY
	tristate "FPC1020"
	depends on FINGERPRINT_ROSY
	help
	  Say Y here to compile fingerprint drivers for FingerPrint Cards
	  FPC1020.

	  If unsure, say Y.
```

## drivers/rosy/fingerprint/goodix/Kconfig
```kconfig
config GF3208_ROSY
	tristate "GF3208"
	depends on FINGERPRINT_ROSY
	help
	  Say Y here to compile fingerprint drivers for Goodix GF3208.

	  If unsure, say Y.
```

## drivers/rosy/power/Kconfig
```kconfig
menuconfig POWER_ROSY
	bool "Power drivers"
	select I2C
	help
	  Say Y here, and a list of supported power drivers will be
	  displayed. This option may affect the kernel.

	  If unsure, say Y.

if POWER_ROSY

config BQ2560_ROSY
	tristate "BQ2560X"
	depends on POWER_ROSY
	help
	  Say Y here to compile power drivers for BQ2560X Battery
	  Charger.

	  If unsure, say Y.

config BQ27426_ROSY
	tristate "BQ27426"
	depends on POWER_ROSY
	help
	  Say Y here to compile power drivers for BQ27426 Battery
	  Fuel Gauge.

	  If unsure, say Y.

endif
```

## drivers/rosy/regulator/Kconfig
```kconfig
menuconfig REGULATOR_ROSY
	bool "Regulator drivers"
	select I2C
	select REGMAP_I2C
	help
	  Say Y here, and a list of supported power regulator drivers
	  will be displayed. This option may affect the kernel.

	  If unsure, say Y.

if REGULATOR_ROSY

config TPS65132_ROSY
	tristate "TPS65132"
	depends on REGULATOR_ROSY
	help
	  Say Y here to compile power regulator drivers for TI
	  TPS65132.

	  If unsure, say Y.

endif
```

## drivers/rosy/soc/Kconfig
```kconfig
menuconfig SOC_ROSY
	bool "SoC drivers"
	help
	  Say Y here, and a list of supported SoC drivers will be
	  displayed. This option doesn't affect the kernel.

	  If unsure, say Y.

if SOC_ROSY

config SERIAL_NUM_ROSY
	bool "CPU serial number"
	depends on SOC_ROSY
	help
	  Say Y here to enable proc interface used to read serial
	  number of CPU. The interface is located at
	  /proc/serial_num

	  If unsure, say Y.

config SECBOOT_FUSE_ROSY
	bool "CPU secure boot fuse"
	depends on SOC_ROSY
	help
	  Say Y here to enable proc interface used to read secure boot
	  fuse setting of CPU. The interface is located at
	  /proc/secboot_fuse_reg

	  If unsure, say Y.

config CPUMAXFREQ_ROSY
	bool "CPU max frequency"
	depends on SOC_ROSY
	help
	  Say Y here to enable proc interface used to get the maximum
	  supported frequency by the CPU. The interface is located at
	  /proc/cpumaxfreq

	  If unsure, say Y.

config BOOT_INFO_ROSY
	bool "Bootloader information"
	depends on SOC_ROSY
	help
	  Say Y here to enable interface used to collect information
	  from ROSY's bootloader and pass it to the kernel.

	  If unsure, say Y.

config HARDWARE_INFO_ROSY
	bool "Hardware information"
	depends on SOC_ROSY
	help
	  Say Y here to enable proc interface used to collect
	  information about the hardware of ROSY. The interface is
	  located at /proc/hwinfo

	  If unsure, say Y.

endif
```

## drivers/rosy/touchscreen/FT8006m/Kconfig
```kconfig
config FT8006M_ROSY
	bool "FT8006M"
	depends on TOUCHSCREEN_ROSY
	help
	  Say Y here to compile touchscreen drivers for FocalTech FT8006M.

	  If unsure, say Y.
```

## drivers/rosy/touchscreen/FT8716/Kconfig
```kconfig
config FT8716_ROSY
	tristate "FT8716"
	depends on TOUCHSCREEN_ROSY
	help
	  Say Y here to compile touchscreen drivers for FocalTech FT8716.

	  If unsure, say Y.
```
